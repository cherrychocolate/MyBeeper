## firmware/esp-audio-pcm-v01/main/Kconfig.projbuild
```kconfig
menu "ID Card audio engineering path"
config IDC_AUDIO_CAPTURE_PROBE
    bool "Initialize actual ES8388/I2S and capture bounded PCM at boot"
    default n
    help
        Enable only after board power, external I2C pullups, AC-coupled LINE1,
        codec address and I2S wiring review. Does not record a phone call.
endmenu
```

## firmware/esp-idf-e6-v01/main/Kconfig.projbuild
```kconfig
menu "ID Card E6 engineering bring-up"
config IDC_E6_RUN_ONCE
    bool "Run physical E6 initialization/white-frame refresh at boot"
    default n
    help
        Enable only after power, BUSY polarity, pinout and HAT wiring review.
        This changes a real panel once per reboot. Not a production service.
endmenu
```
